## Button_Interrupt/build/Kconfig/boards/Kconfig.defconfig
```kconfig
# Load Zephyr board defconfig descriptions.
osource "/home/musman/ncs/nrfSDK/zephyr/boards/nordic/nrf7002dk/Kconfig.defconfig"
```

## Logger_Module/build/Logger_Module/Kconfig/boards/Kconfig
```kconfig
# Load Zephyr board Kconfig descriptions.
osource "/home/musman/ncs/nrfSDK/zephyr/boards/nordic/nrf7002dk/Kconfig"
```

## UART_ThreadQueue_CPP/build/Kconfig/soc/Kconfig
```kconfig
# Load Zephyr SoC Kconfig descriptions.
osource "/home/musman/ncs/nrfSDK/zephyr/soc/xlnx/zynqmp/Kconfig"
osource "/home/musman/ncs/nrfSDK/zephyr/soc/xlnx/zynq7000/Kconfig"
osource "/home/musman/ncs/nrfSDK/zephyr/soc/xlnx/versalnet/Kconfig"
osource "/home/musman/ncs/nrfSDK/zephyr/soc/xlnx/versal2/Kconfig"
osource "/home/musman/ncs/nrfSDK/zephyr/soc/xen/Kconfig"
osource "/home/musman/ncs/nrfSDK/zephyr/soc/wch/ch32v/Kconfig"
osource "/home/musman/ncs/nrfSDK/zephyr/soc/ti/simplelink/Kconfig"
osource "/home/musman/ncs/nrfSDK/zephyr/soc/ti/mspm0/Kconfig"
osource "/home/musman/ncs/nrfSDK/zephyr/soc/ti/lm3s6965/Kconfig"
osource "/home/musman/ncs/nrfSDK/zephyr/soc/ti/k3/Kconfig"
osource "/home/musman/ncs/nrfSDK/zephyr/soc/telink/tlsr/Kconfig"
osource "/home/musman/ncs/nrfSDK/zephyr/soc/starfive/jh71xx/Kconfig"
osource "/home/musman/ncs/nrfSDK/zephyr/soc/st/stm32/Kconfig"
osource "/home/musman/ncs/nrfSDK/zephyr/soc/snps/qemu_arc/Kconfig"
osource "/home/musman/ncs/nrfSDK/zephyr/soc/snps/nsim/arc_v/Kconfig"
osource "/home/musman/ncs/nrfSDK/zephyr/soc/snps/nsim/arc_classic/Kconfig"
osource "/home/musman/ncs/nrfSDK/zephyr/soc/snps/hsdk4xd/Kconfig"
osource "/home/musman/ncs/nrfSDK/zephyr/soc/snps/hsdk/Kconfig"
osource "/home/musman/ncs/nrfSDK/zephyr/soc/snps/emsk/Kconfig"
osource "/home/musman/ncs/nrfSDK/zephyr/soc/snps/emsdp/Kconfig"
osource "/home/musman/ncs/nrfSDK/zephyr/soc/snps/arc_iot/Kconfig"
osource "/home/musman/ncs/nrfSDK/zephyr/soc/silabs/Kconfig"
osource "/home/musman/ncs/nrfSDK/zephyr/soc/sifive/sifive_freedom/Kconfig"
osource "/home/musman/ncs/nrfSDK/zephyr/soc/sensry/Kconfig"
osource "/home/musman/ncs/nrfSDK/zephyr/soc/rockchip/Kconfig"
osource "/home/musman/ncs/nrfSDK/zephyr/soc/renode/riscv_virtual/Kconfig"
osource "/home/musman/ncs/nrfSDK/zephyr/soc/renode/cortex_r8_virtual/Kconfig"
osource "/home/musman/ncs/nrfSDK/zephyr/soc/renesas/smartbond/Kconfig"
osource "/home/musman/ncs/nrfSDK/zephyr/soc/renesas/rz/Kconfig"
osource "/home/musman/ncs/nrfSDK/zephyr/soc/renesas/rx/Kconfig"
osource "/home/musman/ncs/nrfSDK/zephyr/soc/renesas/rcar/Kconfig"
osource "/home/musman/ncs/nrfSDK/zephyr/soc/renesas/ra/Kconfig"
osource "/home/musman/ncs/nrfSDK/zephyr/soc/realtek/ec/Kconfig"
osource "/home/musman/ncs/nrfSDK/zephyr/soc/raspberrypi/rpi_pico/Kconfig"
osource "/home/musman/ncs/nrfSDK/zephyr/soc/quicklogic/eos_s3/Kconfig"
osource "/home/musman/ncs/nrfSDK/zephyr/soc/qemu/virt_riscv/Kconfig"
osource "/home/musman/ncs/nrfSDK/zephyr/soc/qemu/malta/Kconfig"
osource "/home/musman/ncs/nrfSDK/zephyr/soc/openisa/rv32m1/Kconfig"
osource "/home/musman/ncs/nrfSDK/zephyr/soc/openhwgroup/cva6/Kconfig"
osource "/home/musman/ncs/nrfSDK/zephyr/soc/oct/osd32mp15x/Kconfig"
osource "/home/musman/ncs/nrfSDK/zephyr/soc/nxp/s32/Kconfig"
osource "/home/musman/ncs/nrfSDK/zephyr/soc/nxp/rw/Kconfig"
osource "/home/musman/ncs/nrfSDK/zephyr/soc/nxp/mcx/Kconfig"
osource "/home/musman/ncs/nrfSDK/zephyr/soc/nxp/lpc/Kconfig"
osource "/home/musman/ncs/nrfSDK/zephyr/soc/nxp/layerscape/Kconfig"
osource "/home/musman/ncs/nrfSDK/zephyr/soc/nxp/kinetis/Kconfig"
osource "/home/musman/ncs/nrfSDK/zephyr/soc/nxp/imxrt/Kconfig"
osource "/home/musman/ncs/nrfSDK/zephyr/soc/nxp/imx/Kconfig"
osource "/home/musman/ncs/nrfSDK/zephyr/soc/nuvoton/numicro/Kconfig"
osource "/home/musman/ncs/nrfSDK/zephyr/soc/nuvoton/numaker/Kconfig"
osource "/home/musman/ncs/nrfSDK/zephyr/soc/nuvoton/npcx/Kconfig"
osource "/home/musman/ncs/nrfSDK/zephyr/soc/nuvoton/npcm/Kconfig"
osource "/home/musman/ncs/nrfSDK/zephyr/soc/nordic/Kconfig"
osource "/home/musman/ncs/nrfSDK/zephyr/soc/neorv32/Kconfig"
osource "/home/musman/ncs/nrfSDK/zephyr/soc/native/inf_clock/Kconfig"
osource "/home/musman/ncs/nrfSDK/zephyr/soc/microchip/sam/Kconfig"
osource "/home/musman/ncs/nrfSDK/zephyr/soc/microchip/miv/Kconfig"
osource "/home/musman/ncs/nrfSDK/zephyr/soc/microchip/mec/Kconfig"
osource "/home/musman/ncs/nrfSDK/zephyr/soc/mediatek/mt8xxx/Kconfig"
osource "/home/musman/ncs/nrfSDK/zephyr/soc/lowrisc/opentitan/Kconfig"
osource "/home/musman/ncs/nrfSDK/zephyr/soc/litex/litex_vexriscv/Kconfig"
osource "/home/musman/ncs/nrfSDK/zephyr/soc/ite/ec/Kconfig"
osource "/home/musman/ncs/nrfSDK/zephyr/soc/intel/raptor_lake/Kconfig"
osource "/home/musman/ncs/nrfSDK/zephyr/soc/intel/lakemont/Kconfig"
osource "/home/musman/ncs/nrfSDK/zephyr/soc/intel/intel_socfpga_std/Kconfig"
osource "/home/musman/ncs/nrfSDK/zephyr/soc/intel/intel_socfpga/Kconfig"
osource "/home/musman/ncs/nrfSDK/zephyr/soc/intel/intel_niosv/Kconfig"
osource "/home/musman/ncs/nrfSDK/zephyr/soc/intel/intel_ish/Kconfig"
osource "/home/musman/ncs/nrfSDK/zephyr/soc/intel/intel_adsp/Kconfig"
osource "/home/musman/ncs/nrfSDK/zephyr/soc/intel/elkhart_lake/Kconfig"
osource "/home/musman/ncs/nrfSDK/zephyr/soc/intel/atom/Kconfig"
osource "/home/musman/ncs/nrfSDK/zephyr/soc/intel/apollo_lake/Kconfig"
osource "/home/musman/ncs/nrfSDK/zephyr/soc/intel/alder_lake/Kconfig"
osource "/home/musman/ncs/nrfSDK/zephyr/soc/infineon/cat3/Kconfig"
osource "/home/musman/ncs/nrfSDK/zephyr/soc/infineon/cat1c/Kconfig"
osource "/home/musman/ncs/nrfSDK/zephyr/soc/infineon/cat1b/Kconfig"
osource "/home/musman/ncs/nrfSDK/zephyr/soc/infineon/cat1a/Kconfig"
osource "/home/musman/ncs/nrfSDK/zephyr/soc/gd/gd32/Kconfig"
osource "/home/musman/ncs/nrfSDK/zephyr/soc/gaisler/leon3/Kconfig"
osource "/home/musman/ncs/nrfSDK/zephyr/soc/gaisler/gr716a/Kconfig"
osource "/home/musman/ncs/nrfSDK/zephyr/soc/espressif/Kconfig"
osource "/home/musman/ncs/nrfSDK/zephyr/soc/ene/kb1200/Kconfig"
osource "/home/musman/ncs/nrfSDK/zephyr/soc/efinix/sapphire/Kconfig"
osource "/home/musman/ncs/nrfSDK/zephyr/soc/cdns/xtensa_sample_controller/Kconfig"
osource "/home/musman/ncs/nrfSDK/zephyr/soc/cdns/sample_controller32/Kconfig"
osource "/home/musman/ncs/nrfSDK/zephyr/soc/cdns/dc233c/Kconfig"
osource "/home/musman/ncs/nrfSDK/zephyr/soc/brcm/bcmvk/Kconfig"
osource "/home/musman/ncs/nrfSDK/zephyr/soc/brcm/bcm2712/Kconfig"
osource "/home/musman/ncs/nrfSDK/zephyr/soc/brcm/bcm2711/Kconfig"
osource "/home/musman/ncs/nrfSDK/zephyr/soc/bflb/Kconfig"
osource "/home/musman/ncs/nrfSDK/zephyr/soc/atmel/sam0/Kconfig"
osource "/home/musman/ncs/nrfSDK/zephyr/soc/atmel/sam/Kconfig"
osource "/home/musman/ncs/nrfSDK/zephyr/soc/aspeed/Kconfig"
osource "/home/musman/ncs/nrfSDK/zephyr/soc/arm/Kconfig"
osource "/home/musman/ncs/nrfSDK/zephyr/soc/arm/beetle/Kconfig"
osource "/home/musman/ncs/nrfSDK/zephyr/soc/antmicro/myra/Kconfig"
osource "/home/musman/ncs/nrfSDK/zephyr/soc/andestech/Kconfig"
osource "/home/musman/ncs/nrfSDK/zephyr/soc/amd/acp_6_0/Kconfig"
osource "/home/musman/ncs/nrfSDK/zephyr/soc/ambiq/Kconfig"
osource "/home/musman/ncs/nrfSDK/zephyr/soc/aesc/Kconfig"
osource "/home/musman/ncs/nrfSDK/zephyr/soc/adi/max32/Kconfig"
osource "/home/musman/ncs/nrfSDK/nrf/soc/sercomm/nrf91/Kconfig"
osource "/home/musman/ncs/nrfSDK/nrf/soc/nordic/Kconfig"
```

## UART_Thread_Semaphores/build/Kconfig/arch/Kconfig
```kconfig
# Load Zephyr Arch Kconfig descriptions.
osource "/home/musman/ncs/nrfSDK/zephyr/arch/rx/Kconfig"
osource "/home/musman/ncs/nrfSDK/zephyr/arch/x86/Kconfig"
osource "/home/musman/ncs/nrfSDK/zephyr/arch/xtensa/Kconfig"
osource "/home/musman/ncs/nrfSDK/zephyr/arch/sparc/Kconfig"
osource "/home/musman/ncs/nrfSDK/zephyr/arch/riscv/Kconfig"
osource "/home/musman/ncs/nrfSDK/zephyr/arch/posix/Kconfig"
osource "/home/musman/ncs/nrfSDK/zephyr/arch/mips/Kconfig"
osource "/home/musman/ncs/nrfSDK/zephyr/arch/arm64/Kconfig"
osource "/home/musman/ncs/nrfSDK/zephyr/arch/arm/Kconfig"
osource "/home/musman/ncs/nrfSDK/zephyr/arch/arc/Kconfig"
```

## Zephyr_C/UART_Multithreading/build/UART_Multithreading/Kconfig/boards/Kconfig.nrf7002dk
```kconfig
# Load board Kconfig descriptions.
osource "/home/musman/ncs/nrfSDK/zephyr/boards/nordic/nrf7002dk/Kconfig.nrf7002dk"
```
