## prj.conf
```kconfig
#CONFIG_GPIO=y                 "Already enabled in defconfig file"
CONFIG_LOG=y
#CONFIG_SERIAL=y               "Already enabled in defconfig file"
CONFIG_UART_ASYNC_API=y
CONFIG_UART_FUNC=y
CONFIG_LED_FUNC=y
```

## src/led.c
```c
#include <zephyr/kernel.h>        /* For using kernel services as we are using k_msleep() function*/
#include <zephyr/logging/log.h>
#include "led.h"






static bool led_state0 = true;
static bool led_state1 = true;



LOG_MODULE_REGISTER(LED_C,LOG_LEVEL_INF);




Error_Handler led_init()
{
    
	Error_Handler Status_en;
    ret_e ret;

	if (false==gpio_is_ready_dt(&led0) && false==gpio_is_ready_dt(&led1)) /* Check if the device is ready using node led0 device pointer structure value */
	{ 
		Status_en = status_error;
		LOG_INF("LED'S ARE NOT READY");
	}
	
    ret = gpio_pin_configure_dt(&led0, GPIO_OUTPUT_ACTIVE);/* Configure the pin as output using node led0 device pointer structure value */
	if(ret<0)
	{
		Status_en = status_error;
		LOG_INF("LED0 NOT CONFIGURED");
	}
	
	ret = gpio_pin_configure_dt(&led1, GPIO_OUTPUT_ACTIVE);/* Configure the pin as output using node led0 device pointer structure value */
	if(ret<0)
	{
		Status_en = status_error;
		LOG_INF("LED1 NOT CONFIGURED");
	} 
	return Status_en;       
}

void led0_on()
{
gpio_pin_set_dt(&led0,true);
}

void led0_off()
{
gpio_pin_set_dt(&led0,false);
}

void led1_on()
{
gpio_pin_set_dt(&led1,true);
}

void led1_off()
{
gpio_pin_set_dt(&led1,false);
}
```

## src/uartfunc.h
```c
#ifndef UART_FUNC_H
#define UART_FUNC_H

#define RECEIVE_TIMEOUT 10
void uart_init();
void uart_send(uint8_t *tx_buf,size_t len);
#endif
```
