## CMakeLists.txt
```
# SPDX-License-Identifier: Apache-2.0

cmake_minimum_required(VERSION 3.20.0)
find_package(Zephyr REQUIRED HINTS $ENV{ZEPHYR_BASE})
project(BLINKY)

#set(CMAKE_CXX_STANDARD 17)
#set(CMAKE_CXX_STANDARD_REQUIRED ON)

target_sources(app PRIVATE src/main.cpp)
target_sources(app PRIVATE src/drivers/led.cpp)
target_sources(app PRIVATE src/drivers/uart.cpp)
```

## prj.conf
```kconfig
#I/O CONIFG SYSMBOLS

CONFIG_GPIO=y
CONFIG_UART_ASYNC_API=y

#DEBUG UTILITIES
CONFIG_LOG=y

#Enabling C++ Support
CONFIG_CPP=y

#ENABLING LIBC++ SUPPORT AS Zephyr does not include any C++ standard library implementation in source code form. 
CONFIG_GLIBCXX_LIBCPP=y

#ENABLING C++17 SUPPORT
CONFIG_STD_CPP17=y
```

## src/main.cpp
```c
#include <stdio.h> 
#include <zephyr/kernel.h>        /* For using kernel services as we are using k_msleep() function*/
#include <zephyr/drivers/gpio.h>  /* Contains structure gpio_dt_spec, the macros GPIO_DT_SPEC_GET(), and the functions, gpio_is_ready_dt(), gpio_pin_configure_dt() and gpio_pin_toggle_dt().*/


#include "drivers/led.hpp"
#include "drivers/uart.hpp"
/* 1000 msec = 1 sec */
#define SLEEP_TIME_MS   1000


/*
 * A build error on this line means your board is unsupported.
 * See the sample documentation for information on how to fix this.
 */


int main(void)
{
	
	Led led1(0);
	Uart uart1;
	led1.init();
	uart1.init();
	led1.set_delay(1000);
	while (1) 
	{
		led1.on();
		led1.off();   
	}

	return 0;
}
```
